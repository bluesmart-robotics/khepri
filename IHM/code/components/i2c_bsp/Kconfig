## IHM/code/components/i2c_bsp/Kconfig
```kconfig
menu "KHEPRI - bus I2C de la carte"
    config KH_I2C_SDA
        int "Broche SDA"
        default 15
        help
            15 sur la 1.75 ronde, 47 sur la 1.64 rectangulaire.
    config KH_I2C_SCL
        int "Broche SCL"
        default 14
        help
            14 sur la 1.75 ronde, 48 sur la 1.64 rectangulaire.
endmenu
```

## IHM/code/components/kh_common/Kconfig
```kconfig
menu "KHEPRI - commun aux ecrans (liaison, avion, mises a jour)"

    config KHEPRI_ESPNOW_CHANNEL
        int "Canal Wi-Fi de la liaison ESP-NOW"
        range 1 13
        default 1
        help
            Doit etre identique sur les ecrans et sur le maitre (ou la passerelle de simulation).

    config KHEPRI_THRUST_REF_W
        int "Puissance electrique totale (W) affichee comme 100 % de poussee"
        range 500 20000
        default 3500
        help
            Somme M0 + M1 de la puissance de bus (U x I) mesuree par le BSR Drive
            (trame CANSimple Get_Bus_Voltage_Current, 0x017). L'affichage peut depasser 100 %.

    config KHEPRI_BATT_WH
        int "Autonomie : energie utile de la batterie pleine (Wh)"
        range 100 20000
        default 4480
        help
            Utilisee si le BMS ne donne que l'etat de charge. 2 x 7S5P EVE LFP = 4480 Wh.

    config KHEPRI_PV_PEAK_W
        int "Autonomie : puissance solaire crete installee (W)"
        range 50 5000
        default 980
        help
            100 % de la jauge solaire, si le maitre ne la transmet pas. 288 cellules Maxeon Gen III.

    config KHEPRI_LEVEL_POWER_W
        int "Autonomie : puissance electrique du vol en palier (W)"
        range 200 10000
        default 2500
        help
            Heures de palier = energie restante / (cette puissance - production solaire).
            Valeur provisoire, a recaler sur les essais.

    config KHEPRI_ODRV_NODE_M0
        int "Noeud CANSimple du BSR Drive pour le moteur M0"
        range 0 63
        default 0

    config KHEPRI_ODRV_NODE_M1
        int "Noeud CANSimple du BSR Drive pour le moteur M1"
        range 0 63
        default 1

    config KHEPRI_OTA_MANIFEST_URL
        string "OTA : adresse du manifeste version.json de cet ecran"
        default "https://raw.githubusercontent.com/bluesmart-robotics/khepri/main/IHM/code/release/ecran_rond/version.json"

    config KHEPRI_OTA_URL_FIELD
        string "OTA : champ du manifeste qui donne l'image de cette carte"
        default "url"
        help
            Un manifeste peut servir plusieurs revisions de carte (url_V1, url_V1.1...).

    config KHEPRI_OTA_PEER_MANIFEST_URL
        string "OTA : manifeste de l'ecran rond, que cet ecran lui pousse par ESP-NOW (vide = non)"
        default ""
        help
            Renseigne sur l'ecran energie, seul connecte au Wi-Fi.

    config KHEPRI_OTA_PERIOD_S
        int "OTA : periode de verification (s)"
        range 30 86400
        default 60

endmenu
```

## IHM/code/ecran_energie_1.64/main/Kconfig.projbuild
```kconfig
menu "KHEPRI - ecran energie 1.64"

    config KHEPRI_DEMO_DEFAULT
        bool "Simulation locale active au premier demarrage"
        default n
        help
            Normalement non : l'ecran affiche ce que lui relaie l'ecran rond (donnees du maitre,
            ou simulation du rond). La simulation locale sert a tester cet ecran seul.

    config KHEPRI_LCD_CS
        int "Broche CS de l'ecran (V1 : 9, V1.1 : 46)"
        default 9

    config KHEPRI_BOARD_REV
        string "Revision de la carte, affichee dans les reglages"
        default "V1"

endmenu
```

## IHM/code/ecran_rond_1.75/main/Kconfig.projbuild
```kconfig
menu "KHEPRI - ecran rond 1.75 (regime moteur)"

    choice KHEPRI_BOARD
        prompt "Carte"
        default KHEPRI_BOARD_WAVESHARE
        help
            Waveshare : carte ESP32-S3-Touch-AMOLED-1.75(-G) du commerce (AXP2101, bouton PWR
            lu sur le TCA9554, accelerometre QMI8658).
            BSR : carte ecran rond KHEPRI (hardware/BSR flight power module/ecran_rond_1.75) :
            pas de PMU ni d'accelerometre, bouton = BOOT (GPIO0), UART1 vers la carte facade
            sur GPIO17 (TX) / GPIO18 (RX).

        config KHEPRI_BOARD_WAVESHARE
            bool "Waveshare ESP32-S3-Touch-AMOLED-1.75"
        config KHEPRI_BOARD_BSR
            bool "Carte ecran rond KHEPRI (BSR)"
    endchoice

    config KHEPRI_FACADE_UART_BAUD
        int "UART facade : vitesse (bauds)"
        depends on KHEPRI_BOARD_BSR
        range 9600 2000000
        default 115200

    config KHEPRI_DEMO_DEFAULT
        bool "Simulation locale active au premier demarrage"
        default y
        help
            L'ecran genere lui-meme des donnees plausibles (badge SIMULATION) tant qu'on ne
            l'a pas desactivee depuis la page SYSTEME. Le choix est ensuite memorise en NVS.
            A desactiver avant tout vol.

    config KHEPRI_PUSH_MG
        int "Geste : seuil du petit coup vers l'arriere (mg)"
        range 50 2000
        default 120

    config KHEPRI_PUSH_INVERT
        bool "Geste : inverser le sens de la poussee (axe Z)"
        default n

    config KHEPRI_ROLL_DEAD_DEG
        int "Roulis : zone morte (degres)"
        range 0 45
        default 3

    config KHEPRI_ROLL_FULL_DEG
        int "Roulis : angle donnant la vitesse maximale (degres)"
        range 5 90
        default 13

    config KHEPRI_ROLL_RATE_PCT_S
        int "Roulis : vitesse maximale de variation du regime (%/s)"
        range 5 200
        default 40

    config KHEPRI_ROLL_INVERT
        bool "Roulis : inverser droite / gauche"
        default n

endmenu
```

## IHM/code/gateway_sim/sdkconfig.defaults
```kconfig
CONFIG_IDF_TARGET="esp32s3"
CONFIG_ESPTOOLPY_FLASHSIZE_4MB=y
CONFIG_ESP_CONSOLE_USB_SERIAL_JTAG=y
CONFIG_ESPNOW_TASK_STACK_SIZE=6144
```

## IHM/code/main/Kconfig.projbuild
```kconfig
menu "KHEPRI - ecran pilote"

    config KHEPRI_ESPNOW_CHANNEL
        int "Canal Wi-Fi de la liaison ESP-NOW"
        range 1 13
        default 1
        help
            Doit etre identique sur l'ecran et sur le maitre (ou la passerelle de simulation).

    config KHEPRI_DEMO_DEFAULT
        bool "Simulation locale active au premier demarrage"
        default y
        help
            L'ecran genere lui-meme des donnees plausibles (badge SIMULATION) tant qu'on ne
            l'a pas desactivee depuis la page SYSTEME. Le choix est ensuite memorise en NVS.
            A desactiver avant tout vol.

    config KHEPRI_PUSH_MG
        int "Geste : seuil du petit coup vers l'arriere (mg)"
        range 100 2000
        default 350

    config KHEPRI_PUSH_INVERT
        bool "Geste : inverser le sens de la poussee (axe Z)"
        default n

    config KHEPRI_ROLL_DEAD_DEG
        int "Roulis : zone morte (degres)"
        range 0 45
        default 8

    config KHEPRI_ROLL_FULL_DEG
        int "Roulis : angle donnant la vitesse maximale (degres)"
        range 10 90
        default 40

    config KHEPRI_ROLL_RATE_PCT_S
        int "Roulis : vitesse maximale de variation du regime (%/s)"
        range 5 200
        default 40

    config KHEPRI_ROLL_INVERT
        bool "Roulis : inverser droite / gauche"
        default n

    config KHEPRI_THRUST_REF_W
        int "Puissance electrique totale (W) affichee comme 100 % de poussee"
        range 500 20000
        default 3500
        help
            Somme M0 + M1 de la puissance de bus (U x I) mesuree par le BSR Drive
            (trame CANSimple Get_Bus_Voltage_Current, 0x017). L'affichage peut depasser 100 %.

    config KHEPRI_ODRV_NODE_M0
        int "Noeud CANSimple du BSR Drive pour le moteur M0"
        range 0 63
        default 0

    config KHEPRI_ODRV_NODE_M1
        int "Noeud CANSimple du BSR Drive pour le moteur M1"
        range 0 63
        default 1

    config KHEPRI_OTA_MANIFEST_URL
        string "OTA : adresse du manifeste version.json"
        default "https://raw.githubusercontent.com/bluesmart-robotics/khepri/main/IHM/code/release/version.json"

    config KHEPRI_OTA_PERIOD_S
        int "OTA : periode de verification (s)"
        range 30 86400
        default 60

endmenu
```

## khepri_display_175/gateway_sim/main/Kconfig.projbuild
```kconfig
menu "KHEPRI - passerelle de simulation"
    config KHEPRI_ESPNOW_CHANNEL
        int "Canal Wi-Fi de la liaison ESP-NOW"
        range 1 13
        default 1
        help
            Doit etre identique sur l'ecran pilote.
endmenu
```
